## drivers/cpufreq/Kconfig.riscv
```kconfig
# SPDX-License-Identifier: GPL-2.0-only
#
# RISC-V CPU Frequency Scaling drivers
#
config RISCV_RPMI_CPUFREQ
	tristate "RISC-V RPMI Based CPUFreq driver"
	depends on RISCV_SBI || COMPILE_TEST
	default RISCV
	select PM_OPP
	help
	  This adds the CPUfreq driver support for RISC-V platform using SBI
	  RPMI protocol for CPU power management.

	  To compile this driver as a module, choose M here: the
	  module will be called riscv-rpmi-cpufreq.
```

## drivers/firmware/riscv/Kconfig
```kconfig
# SPDX-License-Identifier: GPL-2.0-only
menu "RISC-V Firmware Drivers"
	depends on RISCV || COMPILE_TEST

config RISCV_RPMI_PERFORMANCE
	tristate "RISC-V RPMI performance service group"
	depends on MAILBOX || COMPILE_TEST
	default RISCV
	select PM_OPP
	help
	  Support for the performance service group defined by the RISC-V
	  platform management interface (RPMI) specification. The performance
	  domains advertised by the platform microcontroller are made available
	  to whoever drives them: cpufreq for a domain shared by CPUs, and a
	  device driver, typically through devfreq, for any other IP block.
	  Consumers reference a domain through the "performance-domains"
	  property.

endmenu
```

## drivers/pmdomain/riscv/Kconfig
```kconfig
# SPDX-License-Identifier: GPL-2.0-only

config RISCV_RPMI_DEVICE_POWER
	bool "RISC-V RPMI Based Device Power driver"
	depends on MAILBOX || COMPILE_TEST
	default RISCV
	select PM_GENERIC_DOMAINS if PM
	help
	  Support for device power domains based on RISC-V RPMI Extension

	  To compile this driver as a module, choose M here: the
	  module will be called riscv-rpmi-device-power.
```
